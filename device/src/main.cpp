// IMU data logger for gesture-classifier training data, with an on-device
// touchscreen UI: tap a shot label, tap RECORD, then swing. No laptop-side
// commands needed - the Mac-side tool (device/tools/imu_logger.py) just
// listens and writes out whatever label/stream state the board reports.
//
// Serial protocol (unchanged, still driveable by hand or by the Mac tool):
//   LABEL <name>   STREAM ON   STREAM OFF   HELP
// Sample line: S,<label>,<millis>,ax,ay,az,gx,gy,gz
//
// Board: Waveshare ESP32-S3-Touch-AMOLED-1.8 (V2, CO5300 + CST820 + QMI8658).

#include <Arduino.h>
#include <Wire.h>
#include <WiFi.h>
#include <BLEDevice.h>
#include <BLEServer.h>
#include <BLEUtils.h>
#include <memory>
#include <stdarg.h>
#include "Arduino_GFX_Library.h"
#include "Arduino_DriveBus_Library.h"
#include "SensorQMI8658.hpp"
#include "pin_config.h"
#include "wifi_config.h"  // copy from wifi_config.h.example and fill in your WiFi
#include "gesture_model.h"  // generated by tools/train_classifier.py

Arduino_DataBus *bus = new Arduino_ESP32QSPI(
    LCD_CS, LCD_SCLK, LCD_SDIO0, LCD_SDIO1, LCD_SDIO2, LCD_SDIO3);

Arduino_CO5300 *gfx = new Arduino_CO5300(
    bus, GFX_NOT_DEFINED /* RST */, 0 /* rotation */, LCD_WIDTH, LCD_HEIGHT, 16, 0, 0, 0);

std::shared_ptr<Arduino_IIC_DriveBus> iicBus = std::make_shared<Arduino_HWIIC>(IIC_SDA, IIC_SCL, &Wire);
void onTouchInterrupt(void);
std::unique_ptr<Arduino_IIC> touch(new Arduino_CST816x(
    iicBus, CST816T_DEVICE_ADDRESS, GFX_NOT_DEFINED, TP_INT, onTouchInterrupt));
void onTouchInterrupt(void) { touch->IIC_Interrupt_Flag = true; }

SensorQMI8658 qmi;
bool imuReady = false;

constexpr size_t MAX_LABEL_LENGTH = 24;
char currentLabel[MAX_LABEL_LENGTH] = "still";
bool streaming = false;
uint32_t sampleCount = 0;

constexpr size_t MAX_LINE_LENGTH = 64;
char line[MAX_LINE_LENGTH];
size_t lineLength = 0;

// ---- WiFi transport (untethered logging) --------------------------------
// USB serial keeps working the whole time; the WiFi client is an additional
// sink for the same protocol so you can record swings while unplugged.

constexpr uint16_t TCP_PORT = 3333;
WiFiServer wifiServer(TCP_PORT);
WiFiClient wifiClient;
bool wifiConnected = false;
char wifiStatusLine[40] = "WiFi: connecting...";

// ---- BLE transport (Nordic UART Service - works with any generic BLE
// terminal app too, e.g. nRF Connect/LightBlue, for a manual sanity check) --
// No WiFi network needed at all; the Mac connects directly to the board.

#define NUS_SERVICE_UUID "6E400001-B5A3-F393-E0A9-E50E24DCCA9E"
#define NUS_RX_UUID "6E400002-B5A3-F393-E0A9-E50E24DCCA9E"  // write: Mac -> board
#define NUS_TX_UUID "6E400003-B5A3-F393-E0A9-E50E24DCCA9E"  // notify: board -> Mac

BLEServer *bleServer = nullptr;
BLECharacteristic *bleTx = nullptr;
BLECharacteristic *bleRx = nullptr;
bool bleClientConnected = false;

class BleServerEvents : public BLEServerCallbacks {
  void onConnect(BLEServer *server) override {
    bleClientConnected = true;
    Serial.println("BLE client connected.");
  }
  void onDisconnect(BLEServer *server) override {
    bleClientConnected = false;
    Serial.println("BLE client disconnected.");
    server->getAdvertising()->start();  // resume advertising for the next client
  }
};

// Forward-declared: process() lives further down with the rest of the
// command protocol, but the RX characteristic callback needs it here.
void process(char *command);

class BleRxEvents : public BLECharacteristicCallbacks {
  void onWrite(BLECharacteristic *characteristic) override {
    String value = characteristic->getValue();
    while (value.endsWith("\n") || value.endsWith("\r")) value.remove(value.length() - 1);
    if (value.length() == 0) return;
    char buf[MAX_LABEL_LENGTH + 16];
    strncpy(buf, value.c_str(), sizeof(buf) - 1);
    buf[sizeof(buf) - 1] = '\0';
    process(buf);
  }
};

// A BLE notification can only carry (negotiated MTU - 3) bytes, well under
// one of our ~55-byte sample lines, so split into chunks; the Mac side just
// buffers raw bytes and looks for '\n', exactly like the serial/WiFi paths.
void bleSend(const char *buf, size_t len) {
  if (!bleClientConnected) return;

  // Calling notify() far faster than the NimBLE host can drain its queue
  // (we tried 250Hz) corrupts stack memory and crashes the board. Cap the
  // BLE notification rate; Serial/WiFi are unaffected and stay full-rate.
  static uint32_t lastBleSend = 0;
  constexpr uint32_t BLE_MIN_INTERVAL_MS = 30;  // ~33Hz ceiling
  if (millis() - lastBleSend < BLE_MIN_INTERVAL_MS) return;
  lastBleSend = millis();

  uint16_t mtu = bleServer->getPeerMTU(bleServer->getConnId());
  if (mtu < 23 || mtu > 512) mtu = 23;  // defensive clamp against a bad/unready MTU read
  size_t chunkSize = mtu - 3;
  for (size_t offset = 0; offset < len; offset += chunkSize) {
    size_t n = min(chunkSize, len - offset);
    bleTx->setValue((uint8_t *)(buf + offset), n);
    bleTx->notify();
  }
}

// Write a line to USB serial and, if present, the connected WiFi/BLE client.
void broadcastf(const char *fmt, ...) {
  char buf[128];
  va_list args;
  va_start(args, fmt);
  int len = vsnprintf(buf, sizeof(buf), fmt, args);
  va_end(args);
  Serial.print(buf);
  if (wifiClient && wifiClient.connected()) wifiClient.print(buf);
  if (len > 0) bleSend(buf, min((size_t)len, sizeof(buf) - 1));
}

void setupBle() {
  BLEDevice::init("Tennis Hack IMU");
  BLEDevice::setMTU(247);  // request a big MTU so most sample lines fit in one notification

  bleServer = BLEDevice::createServer();
  bleServer->setCallbacks(new BleServerEvents());

  BLEService *service = bleServer->createService(NUS_SERVICE_UUID);

  // NimBLE (this core's BLE backend) auto-adds the 0x2902 CCCD descriptor
  // for a NOTIFY characteristic - no manual BLE2902 needed.
  bleTx = service->createCharacteristic(NUS_TX_UUID, BLECharacteristic::PROPERTY_NOTIFY);

  bleRx = service->createCharacteristic(NUS_RX_UUID, BLECharacteristic::PROPERTY_WRITE | BLECharacteristic::PROPERTY_WRITE_NR);
  bleRx->setCallbacks(new BleRxEvents());

  service->start();
  BLEAdvertising *advertising = BLEDevice::getAdvertising();
  advertising->addServiceUUID(NUS_SERVICE_UUID);
  advertising->setScanResponse(true);
  BLEDevice::startAdvertising();
  Serial.println("BLE advertising as 'Tennis Hack IMU'.");
}

void connectWiFi() {
  WiFi.mode(WIFI_STA);
  WiFi.begin(WIFI_SSID, WIFI_PASSWORD);
  Serial.printf("Connecting to WiFi '%s'", WIFI_SSID);
  uint32_t start = millis();
  while (WiFi.status() != WL_CONNECTED && millis() - start < 5000) {
    delay(300);
    Serial.print(".");
  }
  Serial.println();

  if (WiFi.status() == WL_CONNECTED) {
    wifiConnected = true;
    wifiServer.begin();
    snprintf(wifiStatusLine, sizeof(wifiStatusLine), "tcp:%s:%u", WiFi.localIP().toString().c_str(), TCP_PORT);
    Serial.printf("WiFi ready - connect to %s\n", wifiStatusLine);
  } else {
    snprintf(wifiStatusLine, sizeof(wifiStatusLine), "WiFi offline (USB only)");
    Serial.printf("WiFi connect failed/timed out - status=%d (0=idle 1=no_ssid 4=connect_failed "
                  "6=disconnected) - USB serial still works.\n",
                  (int)WiFi.status());
  }
}

void pollWifiServer() {
  if (!wifiConnected) return;
  if (wifiServer.hasClient()) {
    if (!wifiClient || !wifiClient.connected()) {
      wifiClient = wifiServer.accept();
      wifiClient.setNoDelay(true);
      Serial.println("WiFi client connected.");
    } else {
      wifiServer.accept().stop();  // only one client at a time
    }
  }
}

// ---- Gesture inference (Play mode) --------------------------------------
// Mirrors tools/segment_swings.py (peak detection) and tools/train_classifier.py
// (feature order + normalize/logits/softmax) exactly, so the on-device result
// matches what training measured. gestureClassNames order MUST match CLASSES
// in train_classifier.py.
bool playMode = false;
// "still" is deliberately not a trained class - see tools/train_classifier.py
// for why (the swing threshold below already gates out genuine stillness
// before inference ever runs, so training against it just hurt the real
// classes' separability).
const char *gestureClassNames[] = {"forehand", "backhand", "serve"};

struct ImuSample {
  float ax, ay, az, gx, gy, gz;
  uint32_t ms;
};

float dynMag(const ImuSample &s) {
  return sqrtf(s.ax * s.ax + s.ay * s.ay + s.az * s.az) - 1.0f;
}

constexpr float SWING_THRESHOLD_G = 1.5f;
// Must match segment_swings.py --pre-ms / --post-ms: features are computed on a
// peak-centered window, not on "whatever we captured after the trigger".
constexpr uint32_t PEAK_PRE_MS = 200;
constexpr uint32_t PEAK_POST_MS = 300;
// Collect long enough that a typical peak (~100ms after trigger) still has
// PEAK_POST_MS of follow-through after we crop.
constexpr uint32_t CAPTURE_COLLECT_MS = 750;
constexpr uint32_t COOLDOWN_MS = 700;
constexpr uint32_t CARD_DISPLAY_MS = 3000;

constexpr size_t PRE_BUFFER_SIZE = 64;  // ~256ms of pre-roll at 250Hz
ImuSample preBuffer[PRE_BUFFER_SIZE];
size_t preBufferHead = 0, preBufferCount = 0;

constexpr size_t MAX_CAPTURE_SAMPLES = 256;  // ~1s at 250Hz, covers CAPTURE_COLLECT_MS
ImuSample captureBuffer[MAX_CAPTURE_SAMPLES];
size_t captureCount = 0;
bool capturing = false;
uint32_t captureStartMs = 0;
uint32_t lastClassifyMs = 0;

// Shot card state, drawn by drawPlayScreen() and cleared after CARD_DISPLAY_MS.
bool cardVisible = false;
uint32_t cardShownMs = 0;
size_t cardClass = 0;
float cardConfidence = 0.0f;
float cardSpeedKmh = 0.0f;

void pushPreBuffer(const ImuSample &s) {
  preBuffer[preBufferHead] = s;
  preBufferHead = (preBufferHead + 1) % PRE_BUFFER_SIZE;
  if (preBufferCount < PRE_BUFFER_SIZE) preBufferCount++;
}

// Same aggregate stats as segment_swings.py's extract_features(), same
// column order as train_classifier.py's FEATURE_COLUMNS: peak_mag_g, then
// (mean,std,min,max) for ax,ay,az,gx,gy,gz in turn.
void computeFeatures(const ImuSample *buf, size_t n, float *out) {
  float peakMag = 0.0f;
  float sums[6] = {0, 0, 0, 0, 0, 0};
  float mins[6], maxs[6];
  for (size_t a = 0; a < 6; a++) {
    mins[a] = 1e9f;
    maxs[a] = -1e9f;
  }
  for (size_t i = 0; i < n; i++) {
    float v[6] = {buf[i].ax, buf[i].ay, buf[i].az, buf[i].gx, buf[i].gy, buf[i].gz};
    float mag = dynMag(buf[i]);
    if (mag > peakMag) peakMag = mag;
    for (size_t a = 0; a < 6; a++) {
      sums[a] += v[a];
      if (v[a] < mins[a]) mins[a] = v[a];
      if (v[a] > maxs[a]) maxs[a] = v[a];
    }
  }
  float means[6];
  for (size_t a = 0; a < 6; a++) means[a] = sums[a] / n;

  float variances[6] = {0, 0, 0, 0, 0, 0};
  for (size_t i = 0; i < n; i++) {
    float v[6] = {buf[i].ax, buf[i].ay, buf[i].az, buf[i].gx, buf[i].gy, buf[i].gz};
    for (size_t a = 0; a < 6; a++) {
      float d = v[a] - means[a];
      variances[a] += d * d;
    }
  }

  size_t idx = 0;
  out[idx++] = peakMag;
  for (size_t a = 0; a < 6; a++) {
    out[idx++] = means[a];
    out[idx++] = sqrtf(variances[a] / n);
    out[idx++] = mins[a];
    out[idx++] = maxs[a];
  }
}

void showShotCard(size_t predicted, float confidence, float speedKmh) {
  cardVisible = true;
  cardShownMs = millis();
  cardClass = predicted;
  cardConfidence = confidence;
  cardSpeedKmh = speedKmh;
}

// Crop captureBuffer to [peak-PEAK_PRE_MS, peak+PEAK_POST_MS] so live features
// match the peak-centered windows in swings_segmented.csv. Trigger-aligned
// windows were ~160ms early / short on follow-through, which shoved real
// forehands toward the serve decision boundary.
void cropToPeakWindow() {
  if (captureCount == 0) return;
  size_t peakIdx = 0;
  float peakMag = dynMag(captureBuffer[0]);
  for (size_t i = 1; i < captureCount; i++) {
    float mag = dynMag(captureBuffer[i]);
    if (mag > peakMag) {
      peakMag = mag;
      peakIdx = i;
    }
  }
  const uint32_t peakMs = captureBuffer[peakIdx].ms;
  size_t dst = 0;
  for (size_t i = 0; i < captureCount; i++) {
    const uint32_t t = captureBuffer[i].ms;
    if (t + PEAK_PRE_MS >= peakMs && t <= peakMs + PEAK_POST_MS) {
      captureBuffer[dst++] = captureBuffer[i];
    }
  }
  captureCount = dst;
}

void classifyCapturedSwing() {
  cropToPeakWindow();
  if (captureCount < 5) {
    broadcastf("SHOT skipped n=%u (window too short after peak crop)\n", (unsigned)captureCount);
    return;
  }

  float features[GESTURE_FEATURE_COUNT];
  computeFeatures(captureBuffer, captureCount, features);

  float normalized[GESTURE_FEATURE_COUNT];
  for (size_t f = 0; f < GESTURE_FEATURE_COUNT; f++) {
    normalized[f] = (features[f] - GESTURE_MEANS[f]) / GESTURE_SCALES[f];
  }

  float logits[GESTURE_CLASS_COUNT];
  for (size_t c = 0; c < GESTURE_CLASS_COUNT; c++) {
    logits[c] = GESTURE_BIASES[c];
    for (size_t f = 0; f < GESTURE_FEATURE_COUNT; f++) {
      logits[c] += GESTURE_WEIGHTS[c][f] * normalized[f];
    }
  }
  float maxLogit = logits[0];
  for (size_t c = 1; c < GESTURE_CLASS_COUNT; c++) {
    if (logits[c] > maxLogit) maxLogit = logits[c];
  }
  float expSum = 0.0f;
  float probs[GESTURE_CLASS_COUNT];
  for (size_t c = 0; c < GESTURE_CLASS_COUNT; c++) {
    probs[c] = expf(logits[c] - maxLogit);
    expSum += probs[c];
  }
  size_t predicted = 0;
  for (size_t c = 0; c < GESTURE_CLASS_COUNT; c++) {
    probs[c] /= expSum;
    if (probs[c] > probs[predicted]) predicted = c;
  }

  // No ground-truth radar speed - a plausible linear estimate from peak swing
  // magnitude, clamped to a sane display range.
  float speedKmh = features[0] * 6.0f;
  if (speedKmh < 15.0f) speedKmh = 15.0f;
  if (speedKmh > 140.0f) speedKmh = 140.0f;

  broadcastf("SHOT %s confidence=%.3f speed_kmh=%.1f peak_mag_g=%.3f n=%u probs=[%.2f,%.2f,%.2f]\n",
             gestureClassNames[predicted], probs[predicted], speedKmh, features[0], (unsigned)captureCount,
             probs[0], probs[1], probs[2]);
  // Raw feature dump, same column order as train_classifier.py's FEATURE_COLUMNS,
  // for comparing a live capture directly against swings_segmented.csv rows.
  broadcastf("FEATURES ");
  for (size_t f = 0; f < GESTURE_FEATURE_COUNT; f++) broadcastf("%.4f,", features[f]);
  broadcastf("\n");
  showShotCard(predicted, probs[predicted], speedKmh);
}

// Called once per new IMU sample while in Play mode. State machine: watch a
// short rolling pre-buffer until dynamic accel crosses the swing threshold,
// then capture a fixed window (seeded with the pre-buffer so we don't miss
// the wind-up) before classifying - same trigger/window idea as
// segment_swings.py, adapted to run causally in real time.
void processPlaySample(const ImuSample &s) {
  if (!capturing) {
    pushPreBuffer(s);
    bool inCooldown = (millis() - lastClassifyMs) < COOLDOWN_MS;
    if (!inCooldown && dynMag(s) >= SWING_THRESHOLD_G) {
      captureCount = 0;
      for (size_t i = 0; i < preBufferCount && captureCount < MAX_CAPTURE_SAMPLES; i++) {
        size_t idx = (preBufferHead + PRE_BUFFER_SIZE - preBufferCount + i) % PRE_BUFFER_SIZE;
        captureBuffer[captureCount++] = preBuffer[idx];
      }
      capturing = true;
      // Anchor to the OLDEST sample actually in the window (the pre-roll we
      // just copied in), not the triggering sample - using s.ms here silently
      // stretched the window to pre-roll + CAPTURE_WINDOW_MS (~780ms measured)
      // instead of the intended ~500ms, diluting mean/std features with extra
      // calm padding until real swings started reading as "still".
      captureStartMs = (captureCount > 0) ? captureBuffer[0].ms : s.ms;
    }
  } else {
    if (captureCount < MAX_CAPTURE_SAMPLES) captureBuffer[captureCount++] = s;
    if (s.ms - captureStartMs >= CAPTURE_WINDOW_MS || captureCount >= MAX_CAPTURE_SAMPLES) {
      classifyCapturedSwing();
      capturing = false;
      lastClassifyMs = millis();
      preBufferHead = 0;
      preBufferCount = 0;  // drop trailing motion so it can't immediately re-trigger
    }
  }
}

// ---- Touch UI ----------------------------------------------------------

struct LabelButton {
  int16_t x, y, w, h;
  const char *text;
  const char *value;
  uint16_t color;
};

// 2x2 grid of shot labels, sized for a 368x448 portrait panel.
LabelButton labelButtons[] = {
    {16, 70, 161, 90, "STILL", "still", RGB565_SLATEGRAY},
    {191, 70, 161, 90, "FOREHAND", "forehand", RGB565_DODGERBLUE},
    {16, 174, 161, 90, "BACKHAND", "backhand", RGB565_ORANGE},
    {191, 174, 161, 90, "SERVE", "serve", RGB565_MEDIUMPURPLE},
};
constexpr size_t LABEL_BUTTON_COUNT = sizeof(labelButtons) / sizeof(labelButtons[0]);

constexpr int16_t RECORD_X = 16, RECORD_Y = 290, RECORD_W = 336, RECORD_H = 80;

bool inside(int16_t px, int16_t py, int16_t x, int16_t y, int16_t w, int16_t h) {
  return px >= x && px < x + w && py >= y && py < y + h;
}

void drawLabelButton(const LabelButton &b, bool selected) {
  gfx->fillRoundRect(b.x, b.y, b.w, b.h, 12, b.color);
  if (selected) gfx->drawRoundRect(b.x - 3, b.y - 3, b.w + 6, b.h + 6, 14, RGB565_WHITE);
  gfx->setTextColor(RGB565_WHITE);
  gfx->setTextSize(2);
  gfx->setCursor(b.x + 14, b.y + b.h / 2 - 8);
  gfx->print(b.text);
}

void drawRecordButton() {
  uint16_t color = streaming ? RGB565_FIREBRICK : RGB565_LIMEGREEN;
  gfx->fillRoundRect(RECORD_X, RECORD_Y, RECORD_W, RECORD_H, 14, color);
  gfx->setTextColor(RGB565_WHITE);
  gfx->setTextSize(3);
  const char *text = streaming ? "STOP" : "RECORD";
  gfx->setCursor(RECORD_X + RECORD_W / 2 - (strlen(text) * 18) / 2, RECORD_Y + RECORD_H / 2 - 12);
  gfx->print(text);
}

void drawStatus() {
  gfx->fillRect(0, 385, LCD_WIDTH, 60, RGB565_BLACK);
  gfx->setTextSize(2);
  gfx->setTextColor(RGB565_WHITE);
  gfx->setCursor(16, 390);
  gfx->printf("label: %s", currentLabel);
  gfx->setCursor(16, 415);
  gfx->printf("samples: %lu", (unsigned long)sampleCount);
}

// Classic signal-fan glyph: a dot plus concentric arc bands swept across the
// top 90 degrees (this library's drawArc has 0 deg at 3 o'clock, sweeping
// clockwise, so 225->315 spans the top of the circle).
constexpr int16_t WIFI_ICON_CX = 20, WIFI_ICON_CY = 60;

void drawWifiIcon(uint16_t color) {
  gfx->fillCircle(WIFI_ICON_CX, WIFI_ICON_CY, 2, color);
  gfx->drawArc(WIFI_ICON_CX, WIFI_ICON_CY, 7, 5, 225, 315, color);
  gfx->drawArc(WIFI_ICON_CX, WIFI_ICON_CY, 12, 10, 225, 315, color);
  gfx->drawArc(WIFI_ICON_CX, WIFI_ICON_CY, 17, 15, 225, 315, color);
}

// The Bluetooth "rune": a vertical spine with an angular zig-zag through it.
constexpr int16_t BLE_ICON_X = 196, BLE_ICON_CY = 60;

void drawBleIcon(uint16_t color) {
  int16_t top = BLE_ICON_CY - 10, bot = BLE_ICON_CY + 10, mid = BLE_ICON_CY;
  int16_t x0 = BLE_ICON_X, x1 = BLE_ICON_X + 8;
  gfx->drawLine(x0, top, x0, bot, color);
  gfx->drawLine(x0, top, x1, top + 5, color);
  gfx->drawLine(x1, top + 5, x0, mid, color);
  gfx->drawLine(x0, mid, x1, bot - 5, color);
  gfx->drawLine(x1, bot - 5, x0, bot, color);
}

void drawConnStatus() {
  gfx->fillRect(0, 40, LCD_WIDTH, 30, RGB565_BLACK);

  bool wifiClientLive = wifiClient && wifiClient.connected();
  uint16_t wifiColor = wifiClientLive ? RGB565_LIMEGREEN : (wifiConnected ? RGB565_GOLD : RGB565_DIMGRAY);
  drawWifiIcon(wifiColor);
  gfx->setTextSize(1);
  gfx->setTextColor(wifiColor);
  gfx->setCursor(42, 56);
  gfx->print(wifiStatusLine);

  uint16_t bleColor = bleClientConnected ? RGB565_LIMEGREEN : RGB565_DODGERBLUE;
  drawBleIcon(bleColor);
  gfx->setTextColor(bleColor);
  gfx->setCursor(212, 56);
  gfx->print(bleClientConnected ? "BLE: paired" : "BLE: advertising");
}

constexpr int16_t MODE_BTN_X = 276, MODE_BTN_Y = 8, MODE_BTN_W = 76, MODE_BTN_H = 28;

void drawModeToggle() {
  gfx->fillRoundRect(MODE_BTN_X, MODE_BTN_Y, MODE_BTN_W, MODE_BTN_H, 8, RGB565_DIMGRAY);
  gfx->setTextColor(RGB565_WHITE);
  gfx->setTextSize(2);
  const char *text = playMode ? "LOG" : "PLAY";
  gfx->setCursor(MODE_BTN_X + MODE_BTN_W / 2 - (strlen(text) * 6), MODE_BTN_Y + 6);
  gfx->print(text);
}

constexpr int16_t CARD_X = 34, CARD_Y = 140, CARD_W = 300, CARD_H = 220;

void drawPlayIdle() {
  gfx->fillRect(0, 80, LCD_WIDTH, LCD_HEIGHT - 80, RGB565_BLACK);
  gfx->setTextSize(2);
  gfx->setTextColor(RGB565_DIMGRAY);
  gfx->setCursor(70, 250);
  gfx->print("SWING TO PLAY");
}

// gestureClassNames and labelButtons are different sets (no "still" in the
// former) with different ordering, so look the card's color/text up by
// matching label value rather than assuming the indices line up.
const LabelButton &labelButtonFor(const char *value) {
  for (size_t i = 0; i < LABEL_BUTTON_COUNT; i++) {
    if (strcmp(labelButtons[i].value, value) == 0) return labelButtons[i];
  }
  return labelButtons[0];
}

void drawShotCard() {
  gfx->fillRect(0, 80, LCD_WIDTH, LCD_HEIGHT - 80, RGB565_BLACK);

  const LabelButton &button = labelButtonFor(gestureClassNames[cardClass]);
  uint16_t color = button.color;
  gfx->drawRoundRect(CARD_X, CARD_Y, CARD_W, CARD_H, 16, color);
  gfx->drawRoundRect(CARD_X + 1, CARD_Y + 1, CARD_W - 2, CARD_H - 2, 15, color);

  const char *name = button.text;
  gfx->setTextSize(3);
  gfx->setTextColor(color);
  gfx->setCursor(CARD_X + CARD_W / 2 - (strlen(name) * 9), CARD_Y + 24);
  gfx->print(name);

  // Confidence bar (this percentage is the model's softmax confidence, i.e.
  // how sure the classifier is - not a measured swing-quality score).
  constexpr int16_t BAR_X = CARD_X + 30, BAR_Y = CARD_Y + 100, BAR_W = CARD_W - 60, BAR_H = 18;
  gfx->fillRoundRect(BAR_X, BAR_Y, BAR_W, BAR_H, 6, RGB565_DIMGRAY);
  int16_t fillW = (int16_t)(BAR_W * cardConfidence);
  if (fillW > 0) gfx->fillRoundRect(BAR_X, BAR_Y, fillW, BAR_H, 6, RGB565_LIMEGREEN);
  gfx->setTextSize(2);
  gfx->setTextColor(RGB565_WHITE);
  char pctText[8];
  snprintf(pctText, sizeof(pctText), "%.0f%%", cardConfidence * 100.0f);
  gfx->setCursor(BAR_X + BAR_W + 8, BAR_Y - 2);
  gfx->print(pctText);

  char speedText[16];
  snprintf(speedText, sizeof(speedText), "%.0f km/h", cardSpeedKmh);
  gfx->setTextSize(3);
  gfx->setTextColor(RGB565_WHITE);
  gfx->setCursor(CARD_X + CARD_W / 2 - (strlen(speedText) * 9), CARD_Y + 160);
  gfx->print(speedText);
}

void drawPlayScreen() {
  if (cardVisible) {
    drawShotCard();
  } else {
    drawPlayIdle();
  }
}

void drawScreen() {
  gfx->fillScreen(RGB565_BLACK);
  gfx->setTextSize(3);
  gfx->setCursor(16, 16);
  gfx->setTextColor(RGB565_LIMEGREEN);
  gfx->print("TENNIS HACK");

  drawModeToggle();
  drawConnStatus();

  if (playMode) {
    drawPlayScreen();
    return;
  }

  for (size_t i = 0; i < LABEL_BUTTON_COUNT; i++) {
    drawLabelButton(labelButtons[i], strcmp(labelButtons[i].value, currentLabel) == 0);
  }
  drawRecordButton();
  drawStatus();
}

void setPlayMode(bool on) {
  playMode = on;
  if (playMode) {
    streaming = false;  // Play mode owns the IMU stream; stop any active logging
  }
  capturing = false;
  preBufferCount = 0;
  preBufferHead = 0;
  cardVisible = false;
  broadcastf("OK MODE %s\n", playMode ? "PLAY" : "LOG");
  drawScreen();
}

void setLabel(const char *value) {
  strncpy(currentLabel, value, MAX_LABEL_LENGTH - 1);
  currentLabel[MAX_LABEL_LENGTH - 1] = '\0';
  sampleCount = 0;
  broadcastf("OK LABEL %s\n", currentLabel);
  drawScreen();
}

void setStreaming(bool on) {
  streaming = on;
  broadcastf("OK STREAM %s\n", streaming ? "ON" : "OFF");
  drawScreen();
}

void handleTap(int16_t x, int16_t y) {
  if (inside(x, y, MODE_BTN_X, MODE_BTN_Y, MODE_BTN_W, MODE_BTN_H)) {
    setPlayMode(!playMode);
    return;
  }
  if (playMode) return;  // Play mode has no other tap targets besides the toggle

  for (size_t i = 0; i < LABEL_BUTTON_COUNT; i++) {
    LabelButton &b = labelButtons[i];
    if (inside(x, y, b.x, b.y, b.w, b.h)) {
      setLabel(b.value);
      return;
    }
  }
  if (inside(x, y, RECORD_X, RECORD_Y, RECORD_W, RECORD_H)) {
    setStreaming(!streaming);
  }
}

void pollTouch() {
  if (!touch->IIC_Interrupt_Flag) return;
  touch->IIC_Interrupt_Flag = false;

  static uint32_t lastTap = 0;
  if (millis() - lastTap < 250) return;  // debounce: state-change IRQ fires on press and release

  int32_t fingers = (int32_t)touch->IIC_Read_Device_Value(Arduino_IIC_Touch::Value_Information::TOUCH_FINGER_NUMBER);
  if (fingers <= 0) return;

  int32_t x = (int32_t)touch->IIC_Read_Device_Value(Arduino_IIC_Touch::Value_Information::TOUCH_COORDINATE_X);
  int32_t y = (int32_t)touch->IIC_Read_Device_Value(Arduino_IIC_Touch::Value_Information::TOUCH_COORDINATE_Y);
  lastTap = millis();
  handleTap((int16_t)x, (int16_t)y);
}

// ---- Serial command protocol (unchanged, so tools/imu_logger.py still works) ----

void help() {
  broadcastf("Commands: LABEL <name>, STREAM ON, STREAM OFF, MODE PLAY, MODE LOG, HELP\n");
  broadcastf("Sample line: S,<label>,<millis>,ax,ay,az,gx,gy,gz\n");
  broadcastf("Shot line: SHOT <name> confidence=<0..1> speed_kmh=<n>\n");
}

void process(char *command) {
  if (strcasecmp(command, "HELP") == 0) { help(); return; }
  if (strncasecmp(command, "LABEL ", 6) == 0) { setLabel(command + 6); return; }
  if (strcasecmp(command, "STREAM ON") == 0) { setStreaming(true); return; }
  if (strcasecmp(command, "STREAM OFF") == 0) { setStreaming(false); return; }
  if (strcasecmp(command, "MODE PLAY") == 0) { setPlayMode(true); return; }
  if (strcasecmp(command, "MODE LOG") == 0) { setPlayMode(false); return; }
  broadcastf("ERROR unknown command; send HELP.\n");
}

void setup() {
  Serial.begin(460800);
  delay(400);
  Serial.println("\nESP32-S3 Tennis Hack - IMU logger");
  help();

  gfx->begin();
  gfx->setBrightness(255);

  // touch->begin() performs Wire.begin(IIC_SDA, IIC_SCL, ...) once for the
  // shared I2C bus; QMI8658 below reuses that same already-initialized Wire.
  if (!touch->begin()) {
    Serial.println("CST820 touch not found - check wiring/address.");
  }

  imuReady = qmi.begin(Wire, QMI8658_L_SLAVE_ADDRESS);
  if (!imuReady) {
    Serial.println("QMI8658 not found - check wiring/address.");
  } else {
    // 250 Hz accel / ~224 Hz gyro: fast enough to resolve a swing's peak,
    // slow enough that 460800 baud ASCII CSV keeps up without dropping lines.
    // LPF_MODE_3 (widest hardware filter, ~13% of ODR) keeps the fast swing
    // transient intact; narrower modes blur the peak we need for detection.
    qmi.configAccelerometer(SensorQMI8658::ACC_RANGE_8G, SensorQMI8658::ACC_ODR_250Hz, SensorQMI8658::LPF_MODE_3);
    qmi.configGyroscope(SensorQMI8658::GYR_RANGE_1024DPS, SensorQMI8658::GYR_ODR_224_2Hz, SensorQMI8658::LPF_MODE_3);
    qmi.enableAccelerometer();
    qmi.enableGyroscope();
    Serial.println("QMI8658 ready (accel 8G/250Hz, gyro 1024DPS/224Hz).");
  }

  setupBle();
  connectWiFi();
  drawScreen();
}

// Drains any available bytes from one command source into the shared line
// buffer. Serial and the WiFi client are never expected to send commands at
// the exact same moment, so sharing one buffer is fine.
void pollCommandSource(Stream &src) {
  while (src.available() > 0) {
    const char input = static_cast<char>(src.read());
    if (input == '\r') continue;
    if (input == '\n') {
      line[lineLength] = '\0';
      process(line);
      lineLength = 0;
    } else if (lineLength < MAX_LINE_LENGTH - 1) {
      line[lineLength++] = input;
    } else {
      lineLength = 0;
      broadcastf("ERROR command too long.\n");
    }
  }
}

void loop() {
  pollWifiServer();

  static bool lastWifiClientLive = false;
  static bool lastBleClientLive = false;
  bool clientLive = wifiClient && wifiClient.connected();
  if (clientLive != lastWifiClientLive || bleClientConnected != lastBleClientLive) {
    lastWifiClientLive = clientLive;
    lastBleClientLive = bleClientConnected;
    drawConnStatus();
  }

  pollCommandSource(Serial);
  if (clientLive) pollCommandSource(wifiClient);

  pollTouch();

  if (playMode && cardVisible && millis() - cardShownMs >= CARD_DISPLAY_MS) {
    cardVisible = false;
    drawPlayIdle();
  }

  if (imuReady && qmi.getDataReady()) {
    IMUdata acc, gyr;
    if (qmi.getAccelerometer(acc.x, acc.y, acc.z) && qmi.getGyroscope(gyr.x, gyr.y, gyr.z)) {
      ImuSample sample{acc.x, acc.y, acc.z, gyr.x, gyr.y, gyr.z, (uint32_t)millis()};

      if (playMode) {
        bool wasCapturing = capturing;
        processPlaySample(sample);
        if (wasCapturing && !capturing) drawShotCard();  // a swing was just classified
      } else if (streaming) {
        broadcastf("S,%s,%lu,%.4f,%.4f,%.4f,%.3f,%.3f,%.3f\n",
                   currentLabel, (unsigned long)millis(), acc.x, acc.y, acc.z, gyr.x, gyr.y, gyr.z);
        sampleCount++;
        // Skip the screen refresh while a BLE client is live: the QSPI display's
        // SPI polling transactions and BLE notify() land in the same hot loop
        // and step on each other ("polling transaction not terminated") badly
        // enough to crash the board. Serial/WiFi streaming still update live.
        if (!bleClientConnected) {
          static uint32_t lastScreenUpdate = 0;
          if (millis() - lastScreenUpdate >= 200) {
            lastScreenUpdate = millis();
            drawStatus();
          }
        }
      }
    }
  }
}
